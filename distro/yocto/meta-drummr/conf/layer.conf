## distro/yocto/meta-drummr/conf/layer.conf
```bitbake
BBPATH .= ":${LAYERDIR}"
BBFILES += "${LAYERDIR}/recipes-*/*/*.bb \
            ${LAYERDIR}/recipes-*/*/*.bbappend"

BBFILE_COLLECTIONS += "drummr"
BBFILE_PATTERN_drummr = "^${LAYERDIR}/"
BBFILE_PRIORITY_drummr = "6"

LAYERSERIES_COMPAT_drummr = "kirkstone mickledore nanbield"
```
